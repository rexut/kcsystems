## Kconfig
```kconfig
#
# For a description of the syntax of this configuration file, see:
# https://gitlab.com/ymorin/kconfig-frontends/-/blob/master/docs/kconfig-language.txt
#

mainmenu "KC Systems Configuration"

config SYSV
	string

menu "Machine Type     "
source "mach/Kconfig"
endmenu

if MACH_SUPPORTS_OSYS
menu "Operating System "
source "osys/Kconfig"
endmenu
endif	# MACH_SUPPORTS_OSYS

menu "Image Composition"
source "images/Kconfig"
endmenu

config EXPERTMODE
	bool
	default n
	prompt "Enable expert mode"

config GENERATE_LISTINGS
	bool
	default n
	prompt "Generate listing files"

config GENERATE_SYMFILES
	bool
	default n
	prompt "Generate symbol files"

# Local variables:
# coding: utf-8
# mode: text
# mode: kconfig
# End:
# vim: fileencoding=utf-8 filetype=kconfig :
```

## images/Kconfig
```kconfig
#
# For a description of the syntax of this configuration file, see:
# https://gitlab.com/ymorin/kconfig-frontends/-/blob/master/docs/kconfig-language.txt
#

config IMAGE_ROM
	bool
	depends on MACH_SUPPORTS_IMAGE_ROM
	prompt "ROM Binary Dump"
	---help---
		Say yes here to generate a ROM image.

config IMAGE_SYS
	bool
	depends on MACH_SUPPORTS_IMAGE_SYS
	prompt "System Track Dump"
	---help---
		Say yes here to generate a system track ready to use as
		system track on a boot floppy disk.

menuconfig IMAGE_DSK
	bool
	depends on MACH_SUPPORTS_IMAGE_DSK
	select IMAGE_SYS
	select IMAGE_DSK_IMG # we need the RAW image for all disk image types
	prompt "System Disk Image"
	---help---
		Say yes here to generate a ready to use boot floppy disk.

if IMAGE_DSK

config IMAGE_DSK_HAVE_FORMAT
	bool

config IMAGE_DSK_LLDFORMAT
	string
	default "scp640"	if IMAGE_DSK_FORMAT_SCP624K
	default "scp800"	if IMAGE_DSK_FORMAT_SCP780K
	default ""		if !IMAGE_DSK_HAVE_FORMAT

config IMAGE_DSK_HLDFORMAT
	string
	default "scp624"	if IMAGE_DSK_FORMAT_SCP624K
	default "scp780"	if IMAGE_DSK_FORMAT_SCP780K
	default ""		if !IMAGE_DSK_HAVE_FORMAT

config IMAGE_DSK_HAVE_FORMAT
	default y	if IMAGE_DSK_FORMAT_SCP624K \
			|| IMAGE_DSK_FORMAT_SCP780K

comment "Machine does not provide any disk image format."
	depends on !MACH_PROVIDES_IMAGE_DSK_FORMAT

choice
	prompt "Disk Image Format"
	depends on MACH_PROVIDES_IMAGE_DSK_FORMAT
	---help---
		Select the logical format of disk image.

config IMAGE_DSK_FORMAT_SCP624K
	bool
	depends on MACH_SUPPORTS_IMAGE_DSK_FORMAT_SCP624K
	prompt "DD/DS-80T 16*256 4ST (624k, SCP)"
	---help---
		640/624/620kB SCP format:

		  - 2 sides per disk (DS)
		  - 80 tracks per side (DD)
		  - 16 sectors per track
		  - 256 byte per sector
		  - 2048 byte BDOS block size
		  - 4 system tracks (16kB)
		  - 128 directory entries (4kB)

config IMAGE_DSK_FORMAT_SCP780K
	bool
	depends on MACH_SUPPORTS_IMAGE_DSK_FORMAT_SCP780K
	prompt "DD/DS-80T 5*1024 4ST (780k, SCP)"
	---help---
		800/780/776kB SCP format:

		  - 2 sides per disk (DS)
		  - 80 tracks per side (DD)
		  - 5 sectors per track
		  - 1024 byte per sector
		  - 2048 byte BDOS block size
		  - 4 system tracks (20kB)
		  - 128 directory entries (4kB)

endchoice

config IMAGE_DSK_IMG
	bool
	prompt "RAW Disk-File"
	---help---
		Say yes here to generate a RAW disk file that is ready to copy
		one by one to a real floppy disk.

config IMAGE_DSK_CPC
	bool
	select IMAGE_DSK_IMG
	prompt "CPCEMU Disk-File"
	---help---
		Say yes here to generate a CPCEMU disk file as defined on the
		CPC Wiki:

		http://www.cpcwiki.eu/index.php/Format:DSK_disk_image_file_format

config IMAGE_DSK_CQM
	bool
	select IMAGE_DSK_IMG
	prompt "CopyQM Disk-File"
	---help---
		Say yes here to generate a CopyQM disk file as defined by Sydex
		and reenigneered by Ralf-Peter Nerlich on his homepage:

		http://rio.early8bitz.de/cqm/
		http://rio.early8bitz.de/cqm/cqm-format.pdf

config IMAGE_DSK_IMD
	bool
	select IMAGE_DSK_IMG
	prompt "ImageDisk File"
	---help---
		Say yes here to generate a ImageDisk file as defined on Dave
		Dunfields homepage:

		http://www.classiccmp.org/dunfield/img/index.htm

config	IMAGE_DSK_AUTOADD_SRCS
	bool
	prompt "Add sources automatically"
	---help---
		Add all used source artefacts to the disk image file
		automatically.

config	IMAGE_DSK_AUTOADD_BINS
	bool
	prompt "Add binaries automatically"
	---help---
		Add all generated binary artefacts to the disk image file
		automatically.

config	IMAGE_DSK_AUTOADD_DEVTOOLS
	bool
	prompt "Add devtools automatically"
	---help---
		Add all tools such as compiler, assembler and linker to the
		disk image file automatically. Only such tools that can be
		executed on the target will be copied.

endif	# IMAGE_DSK

# Local variables:
# coding: utf-8
# mode: text
# mode: kconfig
# End:
# vim: fileencoding=utf-8 filetype=kconfig :
```

## mach/Kconfig
```kconfig
#
# For a description of the syntax of this configuration file, see:
# https://gitlab.com/ymorin/kconfig-frontends/-/blob/master/docs/kconfig-language.txt
#

config MACH
	string

choice
	bool
	prompt "Computer System"
	---help---
		Select the computer system.

endchoice

config MACH_SUPPORTS_OSYS
	bool
	default n

# Local variables:
# coding: utf-8
# mode: text
# mode: kconfig
# End:
# vim: fileencoding=utf-8 filetype=kconfig :
```

## mach/Kconfig.defaults
```kconfig
#
# For a description of the syntax of this configuration file, see:
# https://gitlab.com/ymorin/kconfig-frontends/-/blob/master/docs/kconfig-language.txt
#

config MACH_HAVE_CPM22_BIOS
	bool

config MACH_PROVIDES_IMAGE_DSK_FORMAT
	bool
	default y	if MACH_SUPPORTS_IMAGE_DSK_FORMAT_SCP624K \
			|| MACH_SUPPORTS_IMAGE_DSK_FORMAT_SCP780K

config MACH_PROVIDES_BDOS_BASE
	bool

config MACH_PROVIDED_BDOS_BASE
	hex

config MACH_PROVIDES_BDOS_ROM_OFFS
	bool

config MACH_PROVIDED_BDOS_ROM_OFFS
	int

config MACH_PROVIDES_CCP_BASE
	bool

config MACH_PROVIDED_CCP_BASE
	hex

config MACH_PROVIDES_CCP_ROM_OFFS
	bool

config MACH_PROVIDED_CCP_ROM_OFFS
	int

config MACH_SUPPORTS_OSYS
	bool
	default y	if MACH_SUPPORTS_CPM22 \
			|| MACH_SUPPORTS_CPA1987 \
			|| MACH_SUPPORTS_CPV1988
	default n

config MACH_SUPPORTS_CPM22
	bool

config MACH_SUPPORTS_CPA1987
	bool

config MACH_SUPPORTS_CPV1988
	bool

config MACH_SUPPORTS_IMAGE_ROM
	bool

config MACH_SUPPORTS_IMAGE_SYS
	bool

config MACH_SUPPORTS_IMAGE_DSK
	bool

config MACH_SUPPORTS_IMAGE_DSK_FORMAT_SCP624K
	bool

config MACH_SUPPORTS_IMAGE_DSK_FORMAT_SCP780K
	bool

# Local variables:
# coding: utf-8
# mode: text
# mode: kconfig
# End:
# vim: fileencoding=utf-8 filetype=kconfig :
```

## mach/configs/pcm210-cpv1988-orig6416-rom_defconfig
```kconfig
CONFIG_MACH_PCM_SYS210=y
CONFIG_OSYS_CPV=y
CONFIG_CPV_198810=y
CONFIG_IMAGE_ROM=y
```

## mach/configs/pcm211-cpm22-orig6416-rom_defconfig
```kconfig
CONFIG_MACH_PCM_SYS211=y
CONFIG_OSYS_CPM=y
CONFIG_CPM_22_198002=y
CONFIG_IMAGE_ROM=y
```

## mach/configs/pcm211-cpv1988-orig6416-rom_defconfig
```kconfig
CONFIG_MACH_PCM_SYS211=y
CONFIG_OSYS_CPV=y
CONFIG_CPV_198810_2014=y
CONFIG_IMAGE_ROM=y
```

## mach/configs/pcm330-cpa1987-v2k8024-dsk_defconfig
```kconfig
CONFIG_MACH_PCM_SYS330=y
CONFIG_PCM_VIDEO_VID2K_8024=y
CONFIG_OSYS_CPA=y
CONFIG_CPA_198703=y
CONFIG_IMAGE_DSK=y
CONFIG_IMAGE_DSK_AUTOADD_SRCS=y
CONFIG_IMAGE_DSK_AUTOADD_BINS=y
CONFIG_IMAGE_DSK_AUTOADD_DEVTOOLS=y
```

## mach/configs/pcm331-cpa1987-orig6416-dsk_defconfig
```kconfig
CONFIG_MACH_PCM_SYS331=y
CONFIG_OSYS_CPA=y
CONFIG_CPA_198703_2014=y
CONFIG_IMAGE_DSK=y
CONFIG_IMAGE_DSK_AUTOADD_SRCS=y
CONFIG_IMAGE_DSK_AUTOADD_BINS=y
CONFIG_IMAGE_DSK_AUTOADD_DEVTOOLS=y
```

## mach/configs/pcm331-cpa1987-orig6416-rom_defconfig
```kconfig
CONFIG_MACH_PCM_SYS331=y
CONFIG_OSYS_CPA=y
CONFIG_CPA_198703_2014=y
CONFIG_IMAGE_ROM=y
```

## mach/pcm/2.1x/Kconfig
```kconfig
#
# For a description of the syntax of this configuration file, see:
# https://gitlab.com/ymorin/kconfig-frontends/-/blob/master/docs/kconfig-language.txt
#

if MACH_PCM_SYS21X

config PCM_SDEBUG
	int
	range 0 1
	default 1	if PCM_SYS21X_SVDB
	default 0	if !PCM_SYS21X_SVDB

config PCM_SVTAPE
	int
	range 0 1
	default 1	if PCM_SYS21X_VTAPE
	default 0	if !PCM_SYS21X_VTAPE

comment "Basic I/O System needs a proper hardware configuration"
	depends on !PCM_HAVE_SYS21XHW

menuconfig PCM_SYS21X_BIOS
	bool
	default y
	select MACH_HAVE_CPM22_BIOS
	select OSYS_SUPPORTS_BDOS_IMAGE
	select OSYS_SUPPORTS_CCP_IMAGE
	select MACH_PROVIDES_BDOS_BASE
	select MACH_PROVIDES_CCP_BASE
	select MACH_PROVIDES_CCP_ROM_OFFS	if PCM_EPROM_4X2716
	depends on PCM_HAVE_SYS21XHW
	prompt "Basic I/O System"
	---help---
		Generate the BIOS part and link it to the given address (see
		CONFIG_PCM_SYS21X_BIOS_BASE).

		Say yes here to provide the BIOS as part of the ROM image
		collection.

if PCM_SYS21X_BIOS

config PCM_SYS21X_BIOS_BASE
	hex
	default 0xDDB0
	prompt "BIOS binary image link address" if EXPERTMODE
	---help---
		Binary image link address of the PC/M system 2.1x BIOS.

		The link address is equal to the real base address (0xDE00)
		less the size of the bootstrap code of 0x50.

		Do not change the default value as far as you know what
		you do. The default value is 0xDE00. The resulted default
		link address is 0xDE00 - 0x50 = 0xDDB0.

config PCM_SYS21X_BIOS_ROM_OFFS
	int
	default PCM_ISD14_OFFS
	prompt "BIOS address offset in boot ROM" if EXPERTMODE
	---help---
		Address offset of the PC/M system 2.1x BIOS in boot ROM.

		Do not change the default value as far as you know what
		you do. The default value is PCM_ISD14_OFFS.

endif	# PCM_SYS21X_BIOS

comment "System Visual Debugger needs Basic I/O System"
	depends on !PCM_SYS21X_BIOS

comment "System Visual Debugger"
	depends on PCM_SYS21X_BIOS && !EXPERTMODE

menuconfig PCM_SYS21X_SVDB
	bool
	default y
	depends on PCM_SYS21X_BIOS
	prompt "System Visual Debugger" if EXPERTMODE
	---help---
		Generate the SVDB part and link it to the given address (see
		CONFIG_PCM_SYS21X_SVDB_BASE).

		Say yes here to provide the SVDB as part of the ROM image
		collection.

if PCM_SYS21X_SVDB

config PCM_SYS21X_SVDB_BASE
	hex
	default 0xE800
	prompt "SVDB binary image link address" if EXPERTMODE
	---help---
		Binary image link address of the PC/M system 2.1x SVDB.

		The link address is equal to this base address.

		Do not change the default value as far as you know what
		you do. The default value is 0xE800.

config PCM_SYS21X_SVDB_ROM_OFFS
	int
	default PCM_ISD15_OFFS
	prompt "SVDB address offset in boot ROM" if EXPERTMODE
	---help---
		Address offset of the PC/M system 2.1x SVDB in boot ROM.

		Do not change the default value as far as you know what
		you do. The default value is PCM_ISD15_OFFS.

endif	# PCM_SYS21X_SVDB

comment "Voice Tape Monitor needs Basic I/O System"
	depends on !PCM_SYS21X_BIOS

comment "Voice Tape Monitor"
	depends on PCM_SYS21X_BIOS && !EXPERTMODE

menuconfig PCM_SYS21X_VTAPE
	bool
	default y
	depends on PCM_SYS21X_BIOS
	prompt "Voice Tape Monitor" if EXPERTMODE
	---help---
		Generate the VTAPE part and link it to the given address (see
		CONFIG_PCM_SYS21X_VTAPE_BASE).

		Say yes here to provide the VTAPE as part of the ROM image
		collection.

if PCM_SYS21X_VTAPE

config PCM_SYS21X_VTAPE_BASE
	hex
	default 0xF000
	prompt "VTAPE binary image link address" if EXPERTMODE
	---help---
		Binary image link address of the PC/M system 2.1x VTAPE.

		The link address is equal to this base address.

		Do not change the default value as far as you know what
		you do. The default value is 0xF000.

config PCM_SYS21X_VTAPE_ROM_OFFS
	int
	default PCM_ISD16_OFFS
	prompt "VTAPE address offset in boot ROM" if EXPERTMODE
	---help---
		Address offset of the PC/M system 2.1x VTAPE in boot ROM.

		Do not change the default value as far as you know what
		you do. The default value is PCM_ISD16_OFFS.

endif	# PCM_SYS21X_VTAPE

if PCM_SYS21X_BIOS

config MACH_PROVIDED_BDOS_BASE
	default 0xD000

config MACH_PROVIDED_CCP_BASE
	default 0xC800

config MACH_PROVIDED_CCP_ROM_OFFS
	default PCM_ISD17_OFFS	if PCM_EPROM_4X2716

endif	# PCM_SYS21X_BIOS

endif	# MACH_PCM_SYS21X

# Local variables:
# coding: utf-8
# mode: text
# mode: kconfig
# End:
# vim: fileencoding=utf-8 filetype=kconfig :
```
