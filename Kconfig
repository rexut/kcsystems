## mach/pcm/hw/Kconfig.fdd2
```kconfig
#
# For a description of the syntax of this configuration file, see:
# https://gitlab.com/ymorin/kconfig-frontends/-/blob/master/docs/kconfig-language.txt
#

config PCM_HAVE_FDC_DRV2
	bool
	default y	if PCM_FDC_DRV2 > 0 \
			&& PCM_FDC_DRV2 < 6
	default n

config PCM_FDC_DRV2
	int
	range 0 6	if PCM_FDC_DRVMAX >= 4
	default 0	if PCM_FDC_DRV2_NONE
	default 1	if PCM_FDC_DRV2_MFS12
	default 2	if PCM_FDC_DRV2_IBMXT
	default 3	if PCM_FDC_DRV2_MFS14
	default 4	if PCM_FDC_DRV2_MFS16
	default 5	if PCM_FDC_DRV2_IBMAT
	default 6

choice
	default PCM_FDC_DRV2_MFS14
	prompt "Drive 2 Type "
	---help---
		Select the FDC connected physical type of disk drive 2.

config PCM_FDC_DRV2_NONE
	bool
	prompt "none"
	---help---
		No floppy disk drive connected.

config PCM_FDC_DRV2_MFS12
	bool
	depends on PCM_FDC_ORIG_8272_MFM250
	prompt "MFS 1.2"
	---help---
		MFS 1.2 aka K5600.10 floppy disk drive by
		VEB Buchungsmaschinenwerk Karl-Marx-Stadt:

		  - 5.25 inch disk drive
		  - 300 rotation per minute (RPM)
		  - 125 or 250 kBit/s transfere rate
		  - FM or MFM operation (SD/DD)
		  - 48 tracks per inch (TPI)
		  - 40 tracks per side
		  - single side
		  - max. 200 kB

		This drive is compatible to the original TEAC floppy disk
		drive FD-55A:

		  - max. 6.25 kB per track
		  - max. 250 kB per disk

config PCM_FDC_DRV2_IBMXT
	bool
	depends on PCM_FDC_ORIG_8272_MFM250
	prompt "IBM XT"
	---help---
		IBM XT floppy disk drive:

		  - 5.25 inch disk drive
		  - 300 rotation per minute (RPM)
		  - 125 or 250 kBit/s transfere rate
		  - FM or MFM operation (SD/DD)
		  - 48 tracks per inch (TPI)
		  - 40 tracks per side
		  - double side
		  - max. 400 kB

		This drive is compatible to the original TEAC floppy disk
		drive FD-55B:

		  - max. 6.25 kB per track
		  - max. 500 kB per disk

config PCM_FDC_DRV2_MFS14
	bool
	depends on PCM_FDC_ORIG_8272_MFM250
	prompt "MFS 1.4"
	---help---
		MFS 1.4 aka K5600.20 floppy disk drive by
		VEB Buchungsmaschinenwerk Karl-Marx-Stadt:

		  - 5.25 inch disk drive
		  - 300 rotation per minute (RPM)
		  - 125 or 250 kBit/s transfere rate
		  - FM or MFM operation (SD/DD)
		  - 96 tracks per inch (TPI)
		  - 80 tracks per side
		  - single side
		  - max. 400 kB

		This drive is compatible to the original TEAC floppy disk
		drive FD-55E:

		  - max. 6.25 kB per track
		  - max. 500 kB per disk

config PCM_FDC_DRV2_MFS16
	bool
	depends on PCM_FDC_ORIG_8272_MFM250
	prompt "MFS 1.6"
	---help---
		MFS 1.6 aka K5601 floppy disk drive by
		VEB Buchungsmaschinenwerk Karl-Marx-Stadt:

		  - 5.25 inch disk drive
		  - 300 rotation per minute (RPM)
		  - 125 or 250 kBit/s transfere rate
		  - FM or MFM operation (SD/DD)
		  - 96 tracks per inch (TPI)
		  - 80 tracks per side
		  - double side
		  - max. 800 kB

		This drive is compatible to the original TEAC floppy disk
		drive FD-55F:

		  - max. 6.25 kB per track
		  - max. 1000 kB per disk

config PCM_FDC_DRV2_IBMAT
	bool
	depends on PCM_FDC_ORIG_8272_MFM500
	prompt "IBM AT"
	---help---
		IBM AT floppy disk drive:

		  - 5.25 inch disk drive
		  - 360 rotation per minute (RPM)
		  - 250 or 500 kBit/s transfere rate
		  - FM or MFM operation (SD/DD)
		  - 96 tracks per inch (TPI)
		  - 80 (77) tracks per side
		  - double side
		  - max. 1600 kB (1540 kB)

		This drive is compatible to the original TEAC floppy disk
		drive FD-55G:

		  - max. 10.416 kB per track
		  - max. 1604 kB per disk

endchoice

# Local variables:
# coding: utf-8
# mode: text
# mode: kconfig
# End:
# vim: fileencoding=utf-8 filetype=kconfig :
```

## mach/pcm/hw/Kconfig.keyboard
```kconfig
#
# For a description of the syntax of this configuration file, see:
# https://gitlab.com/ymorin/kconfig-frontends/-/blob/master/docs/kconfig-language.txt
#

config PCM_HAVE_KEYBOARD
	bool
	default y	if PCM_KEYBOARD >= 0 \
			&& PCM_KEYBOARD < 7
	default n

config PCM_KEYBOARD
	int
	range 0 2	if MACH_PCM_SYS21X
	range 0 7	if MACH_PCM_SYS33X
	default 0	if PCM_KEYBOARD_ORIG
	default 1	if PCM_KEYBOARD_K7659
	default 2	if PCM_KEYBOARD_COMMODORE
	default 3	if PCM_KEYBOARD_K7634
	default 4	if PCM_KEYBOARD_K7636
	default 5	if PCM_KEYBOARD_S3004
	default 6	if PCM_KEYBOARD_K7672
	default 7

choice
	default PCM_KEYBOARD_ORIG
	depends on MACH_PCM_SYS21X || MACH_PCM_SYS33X
	prompt "Keyboard     "
	---help---
		Select the PC/M keyboard type.

config PCM_KEYBOARD_ORIG
	bool
	depends on MACH_PCM_SYS21X || MACH_PCM_SYS33X
	prompt "8x10 original"
	---help---
		Original 8x10 matrix keyboard on system PIO port A with recoding
		upper to lower case and vice versa.

		See: http://www.li-pro.net/pcm-hw.phtml
		     Section: 3.2 Tastatur
		     Section: 4.3 Tastatur

		See: http://www.kcclub.de/dlarchiv/DOWNLOAD/DISK269/PC_M1.DOC
		     Section: 3.2 Tastatur
		     Section: 4 Inbetriebnahme --> Tastatur

config PCM_KEYBOARD_K7659
	bool
	depends on MACH_PCM_SYS21X || MACH_PCM_SYS33X
	prompt "K7659"
	---help---
		K7659 OEM mounting keyboard by VEB Robotron-Elektroschaltgeräte
		Auerbach connected to system PIO port A over the 8x12 matrix
		decoder that was published in the German journal "Funkamateur"
		in 1990.

		See: http://www.li-pro.net/pcm-k7659.phtml
		See: http://www.kcclub.de/dlarchiv/DOWNLOAD/DISK269/PC_M7659.DOC

config PCM_KEYBOARD_COMMODORE
	bool
	depends on MACH_PCM_SYS33X
	prompt "Commodore"
	---help---
		Commodore keyboard connected to system PIO port A over the EPR2
		controller that was published in a separated document in 1988.

		See: http://www.kcclub.de/dlarchiv/DOWNLOAD/DISK269/PC_MEPT.DOC

config PCM_KEYBOARD_K7634
	bool
	depends on MACH_PCM_SYS33X
	prompt "K7634/K7604"
	---help---
		K7634/K7604 20-grid HALL keyboard by VEB Robotron-
		Elektroschaltgeräte Auerbach with a parallel interface
		connected to system PIO port A.

config PCM_KEYBOARD_K7636
	bool
	depends on MACH_PCM_SYS33X
	prompt "K7636/K7606"
	---help---
		K7636/K7606 24-grid HALL keyboard by VEB Robotron-
		Elektroschaltgeräte Auerbach with a parallel interface
		connected to system PIO port A.

config PCM_KEYBOARD_S3004
	bool
	depends on MACH_PCM_SYS33X
	prompt "S3004"
	---help---
		S3004 electronic typewriter by VEB Robotron-Optima Erfurt as
		keyboard connected to system SIO port A or B over a serial
		RS-232 interface.

		Note: You have to use the same system SIO port for S3004
		      as keyboard and printer, see PCM_PRINTER_S3004.

config PCM_KEYBOARD_K7672
	bool
	depends on MACH_PCM_SYS33X
	prompt "K7672"
	---help---
		K7672 elastomer keyboard by VEB Robotron-Elektroschaltgeräte
		Auerbach connected to system SIO port A or B over a serial
		IFSS interface.

		Alternatively you can use compatible serial keyboards with
		a serial IFFS interface: K7631/K7637 HALL keyboard

endchoice

# Local variables:
# coding: utf-8
# mode: text
# mode: kconfig
# End:
# vim: fileencoding=utf-8 filetype=kconfig :
```

## mach/pcm/hw/Kconfig.printer
```kconfig
#
# For a description of the syntax of this configuration file, see:
# https://gitlab.com/ymorin/kconfig-frontends/-/blob/master/docs/kconfig-language.txt
#

config PCM_HAVE_PRINTER
	bool
	default y	if PCM_PRINTER >= 0 \
			&& PCM_PRINTER < 5
	default n

config PCM_PRINTER
	int
	range 0 5	if MACH_PCM_SYS33X
	default 0	if PCM_PRINTER_NONE
	default 1	if PCM_PRINTER_SD1152P
	default 2	if PCM_PRINTER_SD1152S
	default 3	if PCM_PRINTER_S3004
	default 4	if PCM_PRINTER_K6313
	default 5

choice
	default PCM_PRINTER_NONE
	depends on MACH_PCM_SYS33X
	prompt "Printer      "
	---help---
		Select the PC/M printer output type.

config PCM_PRINTER_NONE
	bool
	depends on MACH_PCM_SYS33X
	prompt "none"
	---help---
		No printer connected.

config PCM_PRINTER_SD1152P
	bool
	depends on MACH_PCM_SYS33X
	prompt "SD1152/PIO"
	---help---
		SD1152 daisy wheel printer by VEB Büromaschinenwerk
		Sömmerda connected to printer PIO port A or B over a
		special parallel interface.

config PCM_PRINTER_SD1152S
	bool
	depends on MACH_PCM_SYS33X
	prompt "SD1152/SIO"
	---help---
		SD1152/251 daisy wheel printer by VEB Büromaschinenwerk
		Sömmerda connected to system SIO port A or B over a serial
		IFSS or RS-232 interface.

config PCM_PRINTER_S3004
	bool
	depends on MACH_PCM_SYS33X
	prompt "S3004"
	---help---
		S3004 electronic typewriter by VEB Robotron-Optima Erfurt as
		printer connected to system SIO port A or B over a serial
		RS-232 interface.

		Note: You have to use the same system SIO port for S3004
		      as keyboard and printer, see PCM_KEYBOARD_K7672.

config PCM_PRINTER_K6313
	bool
	depends on MACH_PCM_SYS33X
	prompt "K6313/K6314"
	---help---
		K6313/K6314 by VEB Büromaschinenwerk Sömmerda or any other
		Epson LX-86 compatbibel 9-dot matrix printer connected to
		system SIO port A or B over a serial RS-232 interface.

endchoice

# Local variables:
# coding: utf-8
# mode: text
# mode: kconfig
# End:
# vim: fileencoding=utf-8 filetype=kconfig :
```

## mach/pcm/hw/Kconfig.ram
```kconfig
#
# For a description of the syntax of this configuration file, see:
# https://gitlab.com/ymorin/kconfig-frontends/-/blob/master/docs/kconfig-language.txt
#

config PCM_HAVE_RAM
	bool
	default y	if PCM_RAM >= 0 \
			&& PCM_RAM < 2
	default n

config PCM_RAM
	int
	range 0 2	if MACH_PCM_SYS21X
	default 0	if PCM_RAM_8X2164
	default 1	if PCM_RAM_24X2164
	default 2

choice
	default PCM_RAM_24X2164
	depends on MACH_PCM_SYS21X || MACH_PCM_SYS33X
	prompt "System RAM   "
	---help---
		Select the PC/M assembled RAM size.

config PCM_RAM_8X2164
	bool
	depends on MACH_PCM_SYS21X || MACH_PCM_SYS33X
	prompt "64kB RAM" if EXPERTMODE
	---help---
		Minimal assembly with 1x8x64kBit RAM:

		      0000 - FFFF Bank:  0
		---------------------------
		  D0: 1x64kBit ('2164): D20
		  D1: 1x64kBit ('2164): D21
		  D2: 1x64kBit ('2164): D22
		  D3: 1x64kBit ('2164): D23
		  D4: 1x64kBit ('2164): D24
		  D5: 1x64kBit ('2164): D25
		  D6: 1x64kBit ('2164): D26
		  D7: 1x64kBit ('2164): D27

config PCM_RAM_24X2164
	bool
	depends on MACH_PCM_SYS21X || MACH_PCM_SYS33X
	prompt "192kB RAM"
	---help---
		Original assembly with 3x8x64kBit RAM:

		      0000 - FFFF Bank:  0   1   2
		-----------------------------------
		  D0: 1x64kBit ('2164): D20 D28 D36
		  D1: 1x64kBit ('2164): D21 D29 D37
		  D2: 1x64kBit ('2164): D22 D30 D38
		  D3: 1x64kBit ('2164): D23 D31 D39
		  D4: 1x64kBit ('2164): D24 D32 D40
		  D5: 1x64kBit ('2164): D25 D33 D41
		  D6: 1x64kBit ('2164): D26 D34 D42
		  D7: 1x64kBit ('2164): D27 D35 D43

		See: http://www.li-pro.net/pcm-hw.phtml
		     Section: 2.1.6 192 KByte DRAM Block

		See: http://www.kcclub.de/dlarchiv/DOWNLOAD/DISK269/PC_M1.DOC
		     Section: 2.1.6 192 KByte DRAM Block

endchoice

# Local variables:
# coding: utf-8
# mode: text
# mode: kconfig
# End:
# vim: fileencoding=utf-8 filetype=kconfig :
```

## mach/pcm/hw/Kconfig.rom
```kconfig
#
# For a description of the syntax of this configuration file, see:
# https://gitlab.com/ymorin/kconfig-frontends/-/blob/master/docs/kconfig-language.txt
#

config PCM_HAVE_ROM
	bool
	default y	if PCM_ROM >= 0 \
			&& PCM_ROM < 2
	default n

config PCM_ROM
	int
	range 0 1	if MACH_PCM_SYS21X
	range 0 2	if MACH_PCM_SYS33X
	default 0	if PCM_EPROM_4X2716
	default 1	if PCM_EPROM_4X2732
	default 2

choice
	default PCM_EPROM_4X2716
	depends on MACH_PCM_SYS21X || MACH_PCM_SYS33X
	prompt "Boot ROM     "
	---help---
		Select the PC/M boot ROM size.

config PCM_EPROM_4X2716
	bool
	depends on MACH_PCM_SYS21X || MACH_PCM_SYS33X
	prompt "8kB EPROM"
	---help---
		Original assembly with 4x2kB EPROM:

		  D14: 0000 - 07FF 2kB ('2716)
		  D15: 0800 - 0FFF 2kB ('2716)
		  D16: 1000 - 17FF 2kB ('2716)
		  D17: 1800 - 1FFF 2kB ('2716)

		See: http://www.li-pro.net/pcm-hw.phtml
		     Section: 2.1.7 8 KByte EPROM Block

		See: http://www.kcclub.de/dlarchiv/DOWNLOAD/DISK269/PC_M1.DOC
		     Section: 2.1.7 8 KByte EPROM Block

config PCM_EPROM_4X2732
	bool
	depends on MACH_PCM_SYS33X
	prompt "16kB EPROM" if EXPERTMODE
	---help---
		Extended assembly with 4x4kB EPROM:

		  D14: 0000 - 07FF 2kB | 2000 - 27FF 2kB ('2732)
		  D15: 0800 - 0FFF 2kB | 2800 - 2FFF 2kB ('2732)
		  D16: 1000 - 17FF 2kB | 3000 - 37FF 2kB ('2732)
		  D17: 1800 - 1FFF 2kB | 3800 - 3FFF 2kB ('2732)

		See: UMBA2732.PCM

endchoice

config PCM_ISD14_OFFS
	int
	default 0 if PCM_EPROM_4X2716

config PCM_ISD15_OFFS
	int
	default 2048 if PCM_EPROM_4X2716

config PCM_ISD16_OFFS
	int
	default 4096 if PCM_EPROM_4X2716

config PCM_ISD17_OFFS
	int
	default 6144 if PCM_EPROM_4X2716

# Local variables:
# coding: utf-8
# mode: text
# mode: kconfig
# End:
# vim: fileencoding=utf-8 filetype=kconfig :
```

## mach/pcm/hw/Kconfig.sound
```kconfig
#
# For a description of the syntax of this configuration file, see:
# https://gitlab.com/ymorin/kconfig-frontends/-/blob/master/docs/kconfig-language.txt
#

config PCM_HAVE_SOUND
	bool
	default y	if PCM_SOUND >= 0 \
			&& PCM_SOUND < 2
	default n

config PCM_SOUND
	int
	range 0 2	if MACH_PCM_SYS33X
	default 0	if PCM_SOUND_NONE
	default 1	if PCM_SOUND_ORIG
	default 2

choice
	default PCM_SOUND_ORIG
	depends on MACH_PCM_SYS33X
	prompt "Sound & Audio"
	---help---
		Select the PC/M sound and audio type.

config PCM_SOUND_NONE
	bool
	depends on MACH_PCM_SYS33X
	prompt "none"
	---help---
		No sound connected.

config PCM_SOUND_ORIG
	bool
	depends on MACH_PCM_SYS33X
	prompt "CTC original"
	---help---
		Original sound output on system CTC channel 2.

		See: http://www.li-pro.net/pcm-hw.phtml
		     Section: 2.2.2 System-PIO, System-CTC

		See: http://www.kcclub.de/dlarchiv/DOWNLOAD/DISK269/PC_M1.DOC
		     Section: 2.2.2 System-PIO, System-CTC

endchoice

# Local variables:
# coding: utf-8
# mode: text
# mode: kconfig
# End:
# vim: fileencoding=utf-8 filetype=kconfig :
```

## mach/pcm/hw/Kconfig.video
```kconfig
#
# For a description of the syntax of this configuration file, see:
# https://gitlab.com/ymorin/kconfig-frontends/-/blob/master/docs/kconfig-language.txt
#

config PCM_HAVE_VIDEO
	bool
	default y	if PCM_VIDEO >= 0 \
			&& PCM_VIDEO < 4
	default n

config PCM_VIDEO
	int
	range 0 4	if MACH_PCM_SYS33X
	default 0	if PCM_VIDEO_ORIG_6416
	default 1	if PCM_VIDEO_VID2K_8024
	default 2	if PCM_VIDEO_MC6845_6416
	default 3	if PCM_VIDEO_MC6845_8024
	default 4

choice
	default PCM_VIDEO_ORIG_6416
	depends on MACH_PCM_SYS33X
	prompt "Video Card   "
	---help---
		Select the PC/M video output type.

config PCM_VIDEO_ORIG_6416
	bool
	depends on MACH_PCM_SYS33X
	prompt "64/16 original"
	---help---
		Original video card with:

		  - 64 characters per line
		  - 16 lines per screen with gap lines
		  - 7x8 pixel per character
		  - 1k character generator in EPROM

		The 64/16 original viedo card was published in the German
		journal "Funkamateur" in 1988.

		See: http://www.li-pro.net/pcm-hw.phtml
		     Section: 3.1 Bildschirmansteuerung (BAS)
		     Section: 4.2 Bildschirmansteuerung

		See: http://www.kcclub.de/dlarchiv/DOWNLOAD/DISK269/PC_M1.DOC
		     Section: 3.1 Bildschirmansteuerung
		     Section: 4 Inbetriebnahme --> Bildschirmansteuerung

config PCM_VIDEO_VID2K_8024
	bool
	depends on MACH_PCM_SYS33X
	prompt "80/24 (VID2K)"
	---help---
		VID2K video card with:

		  - 80 characters per line
		  - 24 lines per screen
		  - 8x10 pixel per character with cursor line
		  - 2k character generator in EPROM

		The 80/24 (VID2K) viedo card was published in a separated
		document in 1988.

		See: http://www.li-pro.net/pcm-bs-24x80.phtml

config PCM_VIDEO_MC6845_6416
	bool
	depends on MACH_PCM_SYS33X
	prompt "64/16 (MC6845)"
	---help---
		MC6845 based video card with:

		  - 64 characters per line
		  - 16 lines per screen with gap lines

config PCM_VIDEO_MC6845_8024
	bool
	depends on MACH_PCM_SYS33X
	prompt "80/24 (MC6845)"
	---help---
		MC6845 based video card with:

		  - 80 characters per line
		  - 24 lines per screen

endchoice

# Local variables:
# coding: utf-8
# mode: text
# mode: kconfig
# End:
# vim: fileencoding=utf-8 filetype=kconfig :
```
