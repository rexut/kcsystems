## mach/pcm/3.3x/Kconfig.lddc
```kconfig
#
# For a description of the syntax of this configuration file, see:
# https://gitlab.com/ymorin/kconfig-frontends/-/blob/master/docs/kconfig-language.txt
#

config PCM_HAVE_SYS33X_DISKIO_DRVC
	bool
	default y	if PCM_DISKC = "1" \
			|| PCM_DISKC = "2" \
			|| PCM_DISKC = "3" \
			|| PCM_DISKC = "4" \
			|| PCM_DISKC = "5" \
			|| PCM_DISKC = "6" \
			|| PCM_DISKC = "7" \
			|| PCM_DISKC = "8" \
			|| PCM_DISKC = "9" \
			|| PCM_DISKC = "10"

config PCM_DISKC
	string
	default "0"	if PCM_SYS33X_DISKIO_DRVC_NONE
	default "1"	if PCM_SYS33X_DISKIO_DRVC_SCP624K
	default "2"	if PCM_SYS33X_DISKIO_DRVC_SCP780K
	default "3"	if PCM_SYS33X_DISKIO_DRVC_CPA800K
	default "4"	if PCM_SYS33X_DISKIO_DRVC_SCP308K
	default "5"	if PCM_SYS33X_DISKIO_DRVC_CPA400K
	default "6"	if PCM_SYS33X_DISKIO_DRVC_IBM304K
	default "7"	if PCM_SYS33X_DISKIO_DRVC_IBM380K
	default "8"	if PCM_SYS33X_DISKIO_DRVC_IBM400K
	default "9"	if PCM_SYS33X_DISKIO_DRVC_SCP148K
	default "10"	if PCM_SYS33X_DISKIO_DRVC_CPA200K
	depends on MACH_PCM_SYS33X

choice
	default PCM_SYS33X_DISKIO_DRVC_SCP624K
	default PCM_SYS33X_DISKIO_DRVC_SCP308K
	default PCM_SYS33X_DISKIO_DRVC_SCP148K
	default PCM_SYS33X_DISKIO_DRVC_NONE
	prompt "Drive C Type "
	---help---
		Select the logical format of disk drive C.

config PCM_SYS33X_DISKIO_DRVC_NONE
	bool
	prompt "none"
	---help---
		No disk drive configured.

config PCM_SYS33X_DISKIO_DRVC_SCP624K
	bool
	depends on	PCM_FDC_DRV2_IBMAT \
		||	PCM_FDC_DRV2_MFS16
	prompt "DD/DS-80T 16*256 4ST (624k, SCP)"
	---help---
		640/624/620kB SCP format:

		  - 2 sides per disk (DS)
		  - 80 tracks per side (DD)
		  - 16 sectors per track
		  - 256 byte per sector
		  - 2048 byte BDOS block size
		  - 4 system tracks (16kB)
		  - 128 directory entries (4kB)

config PCM_SYS33X_DISKIO_DRVC_SCP780K
	bool
	depends on	PCM_FDC_DRV2_IBMAT \
		||	PCM_FDC_DRV2_MFS16
	prompt "DD/DS-80T 5*1024 4ST (780k, SCP)"
	---help---
		800/780/776kB SCP format:

		  - 2 sides per disk (DS)
		  - 80 tracks per side (DD)
		  - 5 sectors per track
		  - 1024 byte per sector
		  - 2048 byte BDOS block size
		  - 4 system tracks (20kB)
		  - 128 directory entries (4kB)

config PCM_SYS33X_DISKIO_DRVC_CPA800K
	bool
	depends on	PCM_FDC_DRV2_IBMAT \
		||	PCM_FDC_DRV2_MFS16
	prompt "DD/DS-80T 5*1024 0ST (800k, CPA)"
	---help---
		800/800/794kB CPA format:

		  - 2 sides per disk (DS)
		  - 80 tracks per side (DD)
		  - 5 sectors per track
		  - 1024 byte per sector
		  - 2048 byte BDOS block size
		  - no system tracks
		  - 192 directory entries (6kB)

config PCM_SYS33X_DISKIO_DRVC_SCP308K
	bool
	depends on	PCM_FDC_DRV2_IBMAT \
		||	PCM_FDC_DRV2_MFS16 \
		||	PCM_FDC_DRV2_MFS14
	prompt "DD/SS-80T 16*256 3ST (308k, SCP)"
	---help---
		320/308/304kB SCP format:

		  - 1 sides per disk (SS)
		  - 80 tracks per side (DD)
		  - 16 sectors per track
		  - 256 byte per sector
		  - 2048 byte BDOS block size
		  - 3 system tracks (12kB)
		  - 128 directory entries (4kB)

config PCM_SYS33X_DISKIO_DRVC_CPA400K
	bool
	depends on	PCM_FDC_DRV2_IBMAT \
		||	PCM_FDC_DRV2_MFS16 \
		||	PCM_FDC_DRV2_MFS14
	prompt "DD/SS-80T 5*1024 0ST (400k, CPA)"
	---help---
		400/400/396kB CPA format:

		  - 1 sides per disk (DS)
		  - 80 tracks per side (DD)
		  - 5 sectors per track
		  - 1024 byte per sector
		  - 2048 byte BDOS block size
		  - no system tracks
		  - 128 directory entries (4kB)

config PCM_SYS33X_DISKIO_DRVC_IBM304K
	bool
	depends on	PCM_FDC_DRV2_IBMAT \
		||	PCM_FDC_DRV2_MFS16 \
		||	PCM_FDC_DRV2_MFS14 \
		||	PCM_FDC_DRV2_IBMXT
	prompt "DD/DS-40T 16*256 4ST (304k, IBM)"
	---help---
		320/304/300kB IBM format:

		  - 2 sides per disk (DS)
		  - 40 tracks per side (DD)
		  - 16 sectors per track
		  - 256 byte per sector
		  - 2048 byte BDOS block size
		  - 4 system tracks (16kB)
		  - 128 directory entries (4kB)

config PCM_SYS33X_DISKIO_DRVC_IBM380K
	bool
	depends on	PCM_FDC_DRV2_IBMAT \
		||	PCM_FDC_DRV2_MFS16 \
		||	PCM_FDC_DRV2_MFS14 \
		||	PCM_FDC_DRV2_IBMXT
	prompt "DD/DS-40T 5*1024 4ST (380k, IBM)"
	---help---
		400/380/376kB IBM format:

		  - 2 sides per disk (DS)
		  - 40 tracks per side (DD)
		  - 5 sectors per track
		  - 1024 byte per sector
		  - 2048 byte BDOS block size
		  - 4 system tracks (20kB)
		  - 128 directory entries (4kB)

config PCM_SYS33X_DISKIO_DRVC_IBM400K
	bool
	depends on	PCM_FDC_DRV2_IBMAT \
		||	PCM_FDC_DRV2_MFS16 \
		||	PCM_FDC_DRV2_MFS14 \
		||	PCM_FDC_DRV2_IBMXT
	prompt "DD/DS-40T 5*1024 0ST (400k, IBM)"
	---help---
		400/400/396kB IBM format:

		  - 2 sides per disk (DS)
		  - 40 tracks per side (DD)
		  - 5 sectors per track
		  - 1024 byte per sector
		  - 2048 byte BDOS block size
		  - no system tracks
		  - 128 directory entries (4kB)

config PCM_SYS33X_DISKIO_DRVC_SCP148K
	bool
	depends on	PCM_FDC_DRV2_IBMAT \
		||	PCM_FDC_DRV2_MFS16 \
		||	PCM_FDC_DRV2_MFS14 \
		||	PCM_FDC_DRV2_IBMXT \
		||	PCM_FDC_DRV2_MFS12
	prompt "DD/SS-40T 16*256 3ST (148k, SCP)"
	---help---
		160/148/146kB SCP format:

		  - 1 sides per disk (SS)
		  - 40 tracks per side (DD)
		  - 16 sectors per track
		  - 256 byte per sector
		  - 2048 byte BDOS block size
		  - 3 system tracks (12kB)
		  - 64 directory entries (2kB)

config PCM_SYS33X_DISKIO_DRVC_CPA200K
	bool
	depends on	PCM_FDC_DRV2_IBMAT \
		||	PCM_FDC_DRV2_MFS16 \
		||	PCM_FDC_DRV2_MFS14 \
		||	PCM_FDC_DRV2_IBMXT \
		||	PCM_FDC_DRV2_MFS12
	prompt "DD/SS-40T 5*1024 0ST (200k, CPA)"
	---help---
		200/200/198kB CPA format:

		  - 1 sides per disk (DS)
		  - 40 tracks per side (DD)
		  - 5 sectors per track
		  - 1024 byte per sector
		  - 2048 byte BDOS block size
		  - no system tracks
		  - 64 directory entries (2kB)

endchoice

# Local variables:
# coding: utf-8
# mode: text
# mode: kconfig
# End:
# vim: fileencoding=utf-8 filetype=kconfig :
```

## mach/pcm/Kconfig
```kconfig
#
# For a description of the syntax of this configuration file, see:
# https://gitlab.com/ymorin/kconfig-frontends/-/blob/master/docs/kconfig-language.txt
#

if MACH_PCM

config SYSV
	string
	default "2.10"	if MACH_PCM_SYS210
	default "2.11"	if MACH_PCM_SYS211
	default "3.30"	if MACH_PCM_SYS330
	default "3.31"	if MACH_PCM_SYS331
	default ""

choice
	bool
	default MACH_PCM_SYS331
	prompt "PC/M System Version"
	---help---
		Select the PC/M system version.

config MACH_PCM_SYS210
	bool
	prompt "v2.10"
	---help---
		System version 2.10

		This is the original variant and consist the parts:

		  ROM images:
		    - BIOS:  Basic I/O System
		    - SVDB:  System Visual Debugger
		    - VTAPE: Voice Tape Monitor

		Say yes here to generate the original RAM floppy system that
		was published in the German journal "Funkamateur" in 1988.

		This system version can only used together with the operating
		system CP/V (Control Program for V-Tape Microcomputers).

config MACH_PCM_SYS211
	bool
	prompt "v2.11"
	---help---
		System version 2.11

		This is the disassembled variant of 2.10 and consist the parts:

		  Assembler sources:
		    - BIOS:  Basic I/O System
		    - SVDB:  System Visual Debugger
		    - VTAPE: Voice Tape Monitor

		Say yes here to generate the disassembled RAM floppy system that
		was published in the German journal "Funkamateur" in 1988.

		This system version can only used together with the operating
		system CP/V (Control Program for V-Tape Microcomputers).

config MACH_PCM_SYS330
	bool
	prompt "v3.30"
	---help---
		System version 3.30

		This is the original variant and consist the parts:

		  Assembler sources:
		    - BIOS:   Basic I/O System
		    - SVDB:   System Visual Debugger
		    - VTAPE:  Voice Tape Monitor
		    - DISKIO: Disk I/O Driver

		Say yes here to generate the original floppy disk system that
		was published in the German journal "Funkamateur" in 1990.

		This system version can only used together with the operating
		system CP/A (Control Program by AoS of GDR).

config MACH_PCM_SYS331
	bool
	prompt "v3.31"
	---help---
		System version 3.31

		This is the bug fixed version of 3.31 and consist the parts:

		  Assembler sources:
		    - BIOS:   Basic I/O System
		    - SVDB:   System Visual Debugger
		    - VTAPE:  Voice Tape Monitor
		    - DISKIO: Disk I/O Driver

		Say yes here to generate the original floppy disk system that
		was published in the German journal "Funkamateur" in 1990.

		This system version can only used together with the operating
		system CP/A (Control Program by AoS of GDR).

endchoice

config MACH_PCM_SYS21X
	bool
	default y	if MACH_PCM_SYS210 \
			|| MACH_PCM_SYS211
	select MACH_SUPPORTS_IMAGE_ROM
	select MACH_SUPPORTS_CPV1988
	select MACH_SUPPORTS_CPM22

config MACH_PCM_SYS33X
	bool
	default y	if MACH_PCM_SYS330 \
			|| MACH_PCM_SYS331
	select MACH_SUPPORTS_IMAGE_ROM	if !IMAGE_SYS
	select MACH_SUPPORTS_IMAGE_SYS
	select MACH_SUPPORTS_IMAGE_DSK
	select MACH_SUPPORTS_IMAGE_DSK_FORMAT_SCP624K \
			if PCM_SYS33X_DISKIO_DRVB_SCP624K
	select MACH_SUPPORTS_IMAGE_DSK_FORMAT_SCP780K \
			if PCM_SYS33X_DISKIO_DRVB_SCP780K
	select MACH_SUPPORTS_CPA1987	if !IMAGE_ROM

menu "PC/M Hardware Configuration"
source "mach/pcm/hw/Kconfig"
endmenu

menu "PC/M Software Configuration"
source "mach/pcm/2.1x/Kconfig"
source "mach/pcm/3.3x/Kconfig"
endmenu

endif	# MACH_PCM

# Local variables:
# coding: utf-8
# mode: text
# mode: kconfig
# End:
# vim: fileencoding=utf-8 filetype=kconfig :
```

## mach/pcm/hw/Kconfig
```kconfig
#
# For a description of the syntax of this configuration file, see:
# https://gitlab.com/ymorin/kconfig-frontends/-/blob/master/docs/kconfig-language.txt
#

config PCM_HAVE_SYS21XHW
	bool
	default y	if PCM_HAVE_ROM \
			&& PCM_HAVE_RAM \
			&& PCM_HAVE_KEYBOARD

config PCM_HAVE_SYS33XHW
	bool
	default y	if PCM_HAVE_CPUFREQ \
			&& PCM_HAVE_ROM \
			&& PCM_HAVE_RAM \
			&& PCM_HAVE_VIDEO \
			&& PCM_HAVE_KEYBOARD \
			&& PCM_HAVE_SOUND \
			&& PCM_HAVE_PRINTER

source "mach/pcm/hw/Kconfig.clock"
source "mach/pcm/hw/Kconfig.rom"
source "mach/pcm/hw/Kconfig.ram"
source "mach/pcm/hw/Kconfig.video"
source "mach/pcm/hw/Kconfig.keyboard"
source "mach/pcm/hw/Kconfig.sound"
source "mach/pcm/hw/Kconfig.printer"
source "mach/pcm/hw/Kconfig.fdc"

# Local variables:
# coding: utf-8
# mode: text
# mode: kconfig
# End:
# vim: fileencoding=utf-8 filetype=kconfig :
```

## mach/pcm/hw/Kconfig.clock
```kconfig
#
# For a description of the syntax of this configuration file, see:
# https://gitlab.com/ymorin/kconfig-frontends/-/blob/master/docs/kconfig-language.txt
#

config PCM_HAVE_CPUFREQ
	bool
	default y	if PCM_CPUFREQ >= 0 \
			&& PCM_CPUFREQ < 5
	default n

config PCM_CPUFREQ
	int
	range 0 5	if MACH_PCM_SYS33X
	default 0	if PCM_CPUFREQ_20000
	default 1	if PCM_CPUFREQ_24576
	default 2	if PCM_CPUFREQ_25000
	default 3	if PCM_CPUFREQ_36840
	default 4	if PCM_CPUFREQ_40000
	default 5

choice
	default PCM_CPUFREQ_25000
	depends on MACH_PCM_SYS33X
	prompt "CPU Frequency"
	---help---
		Select the PC/M frequency connected to the CPU.

		The CPU frequency is derived from a crystal over a 4:1
		devider. The original assembly have an 10MHz crystal.
		That results in a CPU frequency of 2.5MHz.

		See: http://www.li-pro.net/pcm-hw.phtml
		     Section: 2.1.1 Taktversorgung, Reset-Logik, NMI-Generator

		See: http://www.kcclub.de/dlarchiv/DOWNLOAD/DISK269/PC_M1.DOC
		     Section: 2.1.1 Taktversorgung, Reset-Logik, NMI-Generator

config PCM_CPUFREQ_20000
	bool
	depends on MACH_PCM_SYS33X
	prompt "2.0000 MHz"
	---help---
		Assembly with 2.0000 MHz crystal.

		All interfaces connected to the system CTC will be driven
		with the half of the CPU clock (1.0000 MHz).

config PCM_CPUFREQ_24576
	bool
	depends on MACH_PCM_SYS33X
	prompt "2.4576 MHz"
	---help---
		Original assembly with 2.4576 MHz crystal.

		All interfaces connected to the system CTC will be driven
		directly with the CPU clock (2.4576 MHz).

config PCM_CPUFREQ_25000
	bool
	depends on MACH_PCM_SYS33X
	prompt "2.5000 MHz"
	---help---
		Original assembly with 2.5000 MHz crystal.

		All interfaces connected to the system CTC will be driven
		directly with the CPU clock (2.5000 MHz).

config PCM_CPUFREQ_36840
	bool
	depends on MACH_PCM_SYS33X
	prompt "3.6840 MHz"
	---help---
		Assembly with 3.6840 MHz crystal.

		All interfaces connected to the system CTC will be driven
		with the half of the CPU clock (1.8420 MHz).

config PCM_CPUFREQ_40000
	bool
	depends on MACH_PCM_SYS33X
	prompt "4.0000 MHz"
	---help---
		Assembly with 4.0000 MHz crystal.

		All interfaces connected to the system CTC will be driven
		with the half of the CPU clock (2.0000 MHz).

endchoice

# Local variables:
# coding: utf-8
# mode: text
# mode: kconfig
# End:
# vim: fileencoding=utf-8 filetype=kconfig :
```

## mach/pcm/hw/Kconfig.fdc
```kconfig
#
# For a description of the syntax of this configuration file, see:
# https://gitlab.com/ymorin/kconfig-frontends/-/blob/master/docs/kconfig-language.txt
#

config PCM_HAVE_FDC
	bool
	default y	if PCM_FDC >= 0 \
			&& PCM_FDC < 2
	default n

config PCM_FDC
	int
	range 0 2	if MACH_PCM_SYS33X
	default 0	if PCM_FDC_NONE
	default 1	if PCM_FDC_ORIG_8272_MFM250 \
			|| PCM_FDC_ORIG_8272_MFM500
	default 2

config PCM_FDC_DRVMAX
	int
	range 0 4	if PCM_FDC_ORIG_8272_MFM250 \
			|| PCM_FDC_ORIG_8272_MFM500
	default 0	if PCM_FDC_NONE
	default 4	if PCM_FDC_ORIG_8272_MFM250 \
			|| PCM_FDC_ORIG_8272_MFM500

choice
	default PCM_FDC_ORIG_8272_MFM250
	depends on MACH_PCM_SYS33X
	prompt "System FDC   "
	---help---
		Select the PC/M connected FDC unit.

config PCM_FDC_NONE
	bool
	depends on MACH_PCM_SYS33X
	prompt "none"
	---help---
		No floppy disk controller connected.

config PCM_FDC_ORIG_8272_MFM250
	bool
	depends on MACH_PCM_SYS33X
	prompt "8272 original (MFM 250 kBit/s)"
	---help---
		Original floppy disk controller with:

		  - FDC '8272 at 4MHz
		  - MFM 250 kBit/s by a 2MHz PLL (0.1%)
		  - Support for 5,25" DD disk drives

		The original floppy disk controller was published in the
		German journal "Funkamateur" in 1990.

		See: http://www.li-pro.net/pcm-fdc.phtml

config PCM_FDC_ORIG_8272_MFM500
	bool
	depends on MACH_PCM_SYS33X
	prompt "8272 original (MFM 500 kBit/s)"
	---help---
		Original floppy disk controller with:

		  - FDC '8272 at 8MHz
		  - MFM 500 kBit/s by a 2MHz PLL (0.1%)
		  - Support for 5,25" HD disk drives
		  - Support for 8" DD disk drives

		The original floppy disk controller was published in the
		German journal "Funkamateur" in 1990.

		See: http://www.li-pro.net/pcm-fdc.phtml

endchoice

if PCM_FDC_ORIG_8272_MFM250 || PCM_FDC_ORIG_8272_MFM500
source "mach/pcm/hw/Kconfig.fdd0"
source "mach/pcm/hw/Kconfig.fdd1"
source "mach/pcm/hw/Kconfig.fdd2"
source "mach/pcm/hw/Kconfig.fdd3"
endif

# Local variables:
# coding: utf-8
# mode: text
# mode: kconfig
# End:
# vim: fileencoding=utf-8 filetype=kconfig :
```
