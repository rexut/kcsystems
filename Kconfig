## mach/pcm/3.3x/Kconfig
```kconfig
#
# For a description of the syntax of this configuration file, see:
# https://gitlab.com/ymorin/kconfig-frontends/-/blob/master/docs/kconfig-language.txt
#

if MACH_PCM_SYS33X

config PCM_SCLOCK
	int
	range 0 1
	default 1	if PCM_SYS33X_BIOS_CLOCK
	default 0	if !PCM_SYS33X_BIOS_CLOCK

config PCM_SSTLINE
	int
	range 0 1
	default 1	if PCM_SYS33X_BIOS_STLINE
	default 0	if !PCM_SYS33X_BIOS_STLINE

config PCM_SESCSEQ
	int
	range 0 1
	default 1	if PCM_SYS33X_BIOS_ESCSEQ
	default 0	if !PCM_SYS33X_BIOS_ESCSEQ

config PCM_SFLOPY
	int
	range 0 1
	default 1	if PCM_SYS33X_DISKIO
	default 0	if !PCM_SYS33X_DISKIO

config PCM_SDISKUL
	int
	range 0 1
	default 1	if PCM_SYS33X_DISKIO_URLOAD
	default 0	if !PCM_SYS33X_DISKIO_URLOAD

config PCM_DISKA
	string
	default "0"	if !PCM_SYS33X_DISKIO

config PCM_DISKB
	string
	default "0"	if !PCM_SYS33X_DISKIO

config PCM_DISKC
	string
	default "0"	if !PCM_SYS33X_DISKIO

config PCM_DISKD
	string
	default "0"	if !PCM_SYS33X_DISKIO

config PCM_DISKL
	string
	default "0"	# if !PCM_SYS33X_DISKIO

config PCM_DISKM
	string
	default "0"	# if !PCM_SYS33X_DISKIO

config PCM_DISKO
	string
	default "0"	# if !PCM_SYS33X_DISKIO

config PCM_SDEBUG
	int
	range 0 1
	default 1	if PCM_SYS33X_SVDB
	default 0	if !PCM_SYS33X_SVDB

config PCM_SVTAPE
	int
	range 0 1
	default 1	if PCM_SYS33X_VTAPE
	default 0	if !PCM_SYS33X_VTAPE

config PCM_SYSVER
	int
	range 0 1
	default 1	if IMAGE_SYS || IMAGE_DSK
	default 0	if IMAGE_ROM
	default 0

config PCM_SYS33X_BAS
	bool
	default y	if IMAGE_SYS || IMAGE_DSK
	default n	if IMAGE_ROM
	default n

comment "Basic I/O System needs a proper hardware configuration"
	depends on !PCM_HAVE_SYS33XHW

menuconfig PCM_SYS33X_BIOS
	bool
	default y
	select MACH_HAVE_CPM22_BIOS
	depends on PCM_HAVE_SYS33XHW
	prompt "Basic I/O System"
	---help---
		Generate the BIOS part and link it to the given address (see
		CONFIG_PCM_SYS33X_BIOS_BASE).

		Say yes here to provide the BIOS as part of the ROM or system
		image collection.

if PCM_SYS33X_BIOS

config PCM_SYS33X_BIOS_CLOCK
	bool
	default n
	prompt "System clock"
	---help---
		Provide a runtime system clock over the zero segment at
		address 0x0050.

config PCM_SYS33X_BIOS_STLINE
	bool
	default y
	prompt "Status line"
	---help---
		Provide a status line in the bottom line of screen with
		helpful informations like current disk format and user level.

config PCM_SYS33X_BIOS_ESCSEQ
	bool
	default y
	prompt "ESC sequences"
	---help---
		Interpret ESC sequences inside the console input driver. This
		is needed to support the functionality related to the Ctrl-key
		combinations like Ctrl-_ (0x1F) for warm reboot.

config PCM_SYS33X_BIOS_BASE
	hex
	default 0xD5B0	if !(IMAGE_SYS || IMAGE_DSK)
	default 0xBFF0	if IMAGE_SYS || IMAGE_DSK
	prompt "BIOS ROM image base address" if EXPERTMODE
	---help---
		ROM image base address of the PC/M system 3.3x BIOS.

		The link address is equal to this base address less the
		size of the bootstrap code of 0x50 (ROM) or 0x10 (systrack).

		Do not change the default value as far as you know what
		you do. The default value is 0xD600 (ROM) or 0xC000 (systrack).
		The resulted default link address is 0xD600 - 0x50 = 0xD5B0
		or 0xC000 - 0x10 = 0xBFF0.

endif	# PCM_SYS33X_BIOS

comment "Floppy Disk I/O System needs Basic I/O System"
	depends on !PCM_SYS33X_BIOS

menuconfig PCM_SYS33X_DISKIO
	bool
	default y
	depends on PCM_SYS33X_BIOS
	depends on PCM_HAVE_SYS33XHW && PCM_HAVE_FDC
	prompt "Floppy Disk I/O System"
	---help---
		Generate the DISKIO part and link it into the BIOS.

		Say yes here to provide the floppy disk access as part of
		the ROM or system image collection.

if PCM_SYS33X_DISKIO

config PCM_SYS33X_DISKIO_URLOAD
	bool
	default y
	prompt "Urloader"
	---help---
		Enable support to reload system track from boot disk.

source "mach/pcm/3.3x/Kconfig.ldda"
source "mach/pcm/3.3x/Kconfig.lddb"
source "mach/pcm/3.3x/Kconfig.lddc"
source "mach/pcm/3.3x/Kconfig.lddd"

endif	# PCM_SYS33X_DISKIO

comment "System Visual Debugger Basic I/O System"
	depends on !PCM_SYS33X_BIOS

config PCM_SYS33X_SVDB
	bool
	default n
	depends on PCM_SYS33X_BIOS
	prompt "System Visual Debugger"
	---help---
		Generate the SVDB part and link it into the BIOS.

		Say yes here to provide the SVDB as part of the ROM or system
		image collection.

comment "Voice Tape Monitor Basic I/O System"
	depends on !PCM_SYS33X_BIOS

config PCM_SYS33X_VTAPE
	bool
	default y
	depends on PCM_SYS33X_BIOS
	prompt "Voice Tape Monitor"
	---help---
		Generate the VTAPE part and link it into the BIOS.

		Say yes here to provide the SVDB as part of the ROM or system
		image collection.

endif	# MACH_PCM_SYS33X

# Local variables:
# coding: utf-8
# mode: text
# mode: kconfig
# End:
# vim: fileencoding=utf-8 filetype=kconfig :
```

## mach/pcm/3.3x/Kconfig.ldda
```kconfig
#
# For a description of the syntax of this configuration file, see:
# https://gitlab.com/ymorin/kconfig-frontends/-/blob/master/docs/kconfig-language.txt
#

config PCM_HAVE_SYS33X_DISKIO_DRVA
	bool
	default y	if PCM_DISKA = "\'Q\'" \
			|| PCM_DISKA = "\'R\'" \
			|| PCM_DISKA = "1" \
			|| PCM_DISKA = "2" \
			|| PCM_DISKA = "3" \
			|| PCM_DISKA = "4" \
			|| PCM_DISKA = "5" \
			|| PCM_DISKA = "6" \
			|| PCM_DISKA = "7" \
			|| PCM_DISKA = "8" \
			|| PCM_DISKA = "9" \
			|| PCM_DISKA = "10"

config PCM_DISKA
	string
	default "0"	if PCM_SYS33X_DISKIO_DRVA_NONE
	default "\'Q\'"	if PCM_SYS33X_DISKIO_DRVA_SYSRAMFD124K
	default "\'R\'"	if PCM_SYS33X_DISKIO_DRVA_SYSRAMFD118K
	default "1"	if PCM_SYS33X_DISKIO_DRVA_SCP624K
	default "2"	if PCM_SYS33X_DISKIO_DRVA_SCP780K
	default "3"	if PCM_SYS33X_DISKIO_DRVA_CPA800K
	default "4"	if PCM_SYS33X_DISKIO_DRVA_SCP308K
	default "5"	if PCM_SYS33X_DISKIO_DRVA_CPA400K
	default "6"	if PCM_SYS33X_DISKIO_DRVA_IBM304K
	default "7"	if PCM_SYS33X_DISKIO_DRVA_IBM380K
	default "8"	if PCM_SYS33X_DISKIO_DRVA_IBM400K
	default "9"	if PCM_SYS33X_DISKIO_DRVA_SCP148K
	default "10"	if PCM_SYS33X_DISKIO_DRVA_CPA200K
	depends on MACH_PCM_SYS33X

choice
	default PCM_SYS33X_DISKIO_DRVA_SYSRAMFD124K
	default PCM_SYS33X_DISKIO_DRVA_SYSRAMFD118K
	default PCM_SYS33X_DISKIO_DRVA_SCP624K
	default PCM_SYS33X_DISKIO_DRVA_SCP308K
	default PCM_SYS33X_DISKIO_DRVA_SCP148K
	default PCM_SYS33X_DISKIO_DRVA_NONE
	prompt "Drive A Type "
	---help---
		Select the logical format of disk drive A.

config PCM_SYS33X_DISKIO_DRVA_NONE
	bool
	prompt "none"
	---help---
		No disk drive configured.

config PCM_SYS33X_DISKIO_DRVA_SYSRAMFD124K
	bool
	depends on !PCM_EPROM_4X2716 && PCM_EPROM_4X2732
	prompt "System-RAM-Floppy (124k)"

config PCM_SYS33X_DISKIO_DRVA_SYSRAMFD118K
	bool
	depends on PCM_EPROM_4X2716 && !PCM_EPROM_4X2732
	prompt "System-RAM-Floppy (118k)"

config PCM_SYS33X_DISKIO_DRVA_SCP624K
	bool
	depends on	PCM_FDC_DRV0_IBMAT \
		||	PCM_FDC_DRV0_MFS16
	prompt "DD/DS-80T 16*256 4ST (624k, SCP)"
	---help---
		640/624/620kB SCP format:

		  - 2 sides per disk (DS)
		  - 80 tracks per side (DD)
		  - 16 sectors per track
		  - 256 byte per sector
		  - 2048 byte BDOS block size
		  - 4 system tracks (16kB)
		  - 128 directory entries (4kB)

config PCM_SYS33X_DISKIO_DRVA_SCP780K
	bool
	depends on	PCM_FDC_DRV0_IBMAT \
		||	PCM_FDC_DRV0_MFS16
	prompt "DD/DS-80T 5*1024 4ST (780k, SCP)"
	---help---
		800/780/776kB SCP format:

		  - 2 sides per disk (DS)
		  - 80 tracks per side (DD)
		  - 5 sectors per track
		  - 1024 byte per sector
		  - 2048 byte BDOS block size
		  - 4 system tracks (20kB)
		  - 128 directory entries (4kB)

config PCM_SYS33X_DISKIO_DRVA_CPA800K
	bool
	depends on	PCM_FDC_DRV0_IBMAT \
		||	PCM_FDC_DRV0_MFS16
	prompt "DD/DS-80T 5*1024 0ST (800k, CPA)"
	---help---
		800/800/794kB CPA format:

		  - 2 sides per disk (DS)
		  - 80 tracks per side (DD)
		  - 5 sectors per track
		  - 1024 byte per sector
		  - 2048 byte BDOS block size
		  - no system tracks
		  - 192 directory entries (6kB)

config PCM_SYS33X_DISKIO_DRVA_SCP308K
	bool
	depends on	PCM_FDC_DRV0_IBMAT \
		||	PCM_FDC_DRV0_MFS16 \
		||	PCM_FDC_DRV0_MFS14
	prompt "DD/SS-80T 16*256 3ST (308k, SCP)"
	---help---
		320/308/304kB SCP format:

		  - 1 sides per disk (SS)
		  - 80 tracks per side (DD)
		  - 16 sectors per track
		  - 256 byte per sector
		  - 2048 byte BDOS block size
		  - 3 system tracks (12kB)
		  - 128 directory entries (4kB)

config PCM_SYS33X_DISKIO_DRVA_CPA400K
	bool
	depends on	PCM_FDC_DRV0_IBMAT \
		||	PCM_FDC_DRV0_MFS16 \
		||	PCM_FDC_DRV0_MFS14
	prompt "DD/SS-80T 5*1024 0ST (400k, CPA)"
	---help---
		400/400/396kB CPA format:

		  - 1 sides per disk (DS)
		  - 80 tracks per side (DD)
		  - 5 sectors per track
		  - 1024 byte per sector
		  - 2048 byte BDOS block size
		  - no system tracks
		  - 128 directory entries (4kB)

config PCM_SYS33X_DISKIO_DRVA_IBM304K
	bool
	depends on	PCM_FDC_DRV0_IBMAT \
		||	PCM_FDC_DRV0_MFS16 \
		||	PCM_FDC_DRV0_MFS14 \
		||	PCM_FDC_DRV0_IBMXT
	prompt "DD/DS-40T 16*256 4ST (304k, IBM)"
	---help---
		320/304/300kB IBM format:

		  - 2 sides per disk (DS)
		  - 40 tracks per side (DD)
		  - 16 sectors per track
		  - 256 byte per sector
		  - 2048 byte BDOS block size
		  - 4 system tracks (16kB)
		  - 128 directory entries (4kB)

config PCM_SYS33X_DISKIO_DRVA_IBM380K
	bool
	depends on	PCM_FDC_DRV0_IBMAT \
		||	PCM_FDC_DRV0_MFS16 \
		||	PCM_FDC_DRV0_MFS14 \
		||	PCM_FDC_DRV0_IBMXT
	prompt "DD/DS-40T 5*1024 4ST (380k, IBM)"
	---help---
		400/380/376kB IBM format:

		  - 2 sides per disk (DS)
		  - 40 tracks per side (DD)
		  - 5 sectors per track
		  - 1024 byte per sector
		  - 2048 byte BDOS block size
		  - 4 system tracks (20kB)
		  - 128 directory entries (4kB)

config PCM_SYS33X_DISKIO_DRVA_IBM400K
	bool
	depends on	PCM_FDC_DRV0_IBMAT \
		||	PCM_FDC_DRV0_MFS16 \
		||	PCM_FDC_DRV0_MFS14 \
		||	PCM_FDC_DRV0_IBMXT
	prompt "DD/DS-40T 5*1024 0ST (400k, IBM)"
	---help---
		400/400/396kB IBM format:

		  - 2 sides per disk (DS)
		  - 40 tracks per side (DD)
		  - 5 sectors per track
		  - 1024 byte per sector
		  - 2048 byte BDOS block size
		  - no system tracks
		  - 128 directory entries (4kB)

config PCM_SYS33X_DISKIO_DRVA_SCP148K
	bool
	depends on	PCM_FDC_DRV0_IBMAT \
		||	PCM_FDC_DRV0_MFS16 \
		||	PCM_FDC_DRV0_MFS14 \
		||	PCM_FDC_DRV0_IBMXT \
		||	PCM_FDC_DRV0_MFS12
	prompt "DD/SS-40T 16*256 3ST (148k, SCP)"
	---help---
		160/148/146kB SCP format:

		  - 1 sides per disk (SS)
		  - 40 tracks per side (DD)
		  - 16 sectors per track
		  - 256 byte per sector
		  - 2048 byte BDOS block size
		  - 3 system tracks (12kB)
		  - 64 directory entries (2kB)

config PCM_SYS33X_DISKIO_DRVA_CPA200K
	bool
	depends on	PCM_FDC_DRV0_IBMAT \
		||	PCM_FDC_DRV0_MFS16 \
		||	PCM_FDC_DRV0_MFS14 \
		||	PCM_FDC_DRV0_IBMXT \
		||	PCM_FDC_DRV0_MFS12
	prompt "DD/SS-40T 5*1024 0ST (200k, CPA)"
	---help---
		200/200/198kB CPA format:

		  - 1 sides per disk (DS)
		  - 40 tracks per side (DD)
		  - 5 sectors per track
		  - 1024 byte per sector
		  - 2048 byte BDOS block size
		  - no system tracks
		  - 64 directory entries (2kB)

endchoice

# Local variables:
# coding: utf-8
# mode: text
# mode: kconfig
# End:
# vim: fileencoding=utf-8 filetype=kconfig :
```
