## osys/Kconfig
```kconfig
#
# For a description of the syntax of this configuration file, see:
# https://gitlab.com/ymorin/kconfig-frontends/-/blob/master/docs/kconfig-language.txt
#

config OSYS
	string

choice
	depends on MACH_SUPPORTS_OSYS
	bool
	prompt "Operating System"
	---help---
		Select the operating system.

endchoice

# Local variables:
# coding: utf-8
# mode: text
# mode: kconfig
# End:
# vim: fileencoding=utf-8 filetype=kconfig :
```

## osys/Kconfig.defaults
```kconfig
#
# For a description of the syntax of this configuration file, see:
# https://gitlab.com/ymorin/kconfig-frontends/-/blob/master/docs/kconfig-language.txt
#

config OSYS_IS_CPM22
	bool
	default y	if MACH_HAVE_CPM22_BIOS \
			&& OSYS_HAVE_CPM22_BDOS \
			&& OSYS_HAVE_CPM22_CCP

config OSYS_HAVE_CPM22_BDOS
	bool

config OSYS_HAVE_CPM22_CCP
	bool

config OSYS_SUPPORTS_BDOS_IMAGE
	bool

config OSYS_SUPPORTS_CCP_IMAGE
	bool

# Local variables:
# coding: utf-8
# mode: text
# mode: kconfig
# End:
# vim: fileencoding=utf-8 filetype=kconfig :
```

## osys/cpa/Kconfig
```kconfig
#
# For a description of the syntax of this configuration file, see:
# https://gitlab.com/ymorin/kconfig-frontends/-/blob/master/docs/kconfig-language.txt
#

if OSYS_CPA

choice
	default CPA_198703
	depends on OSYS_CPA
	prompt "CP/A Version"
	---help---
		Select the CP/A version.

config CPA_198703
	bool
	prompt "1987/03"
	---help---
		CP/A Operating System version of March 1987

		This is the original variant and consist the parts:

		  ROM/RAM images:
		    - CCP:  Console Command Processor
		    - BDOS: Basic Disk Operating System

		Say yes here to generate the original CP/A operating system
		that was published in March 1987 by Academy of Sciences
		of the GDR, Institute of Computer Science and Technology.

endchoice

endif	# OSYS_CPA

# Local variables:
# coding: utf-8
# mode: text
# mode: kconfig
# End:
# vim: fileencoding=utf-8 filetype=kconfig :
```

## osys/cpm/Kconfig
```kconfig
#
# For a description of the syntax of this configuration file, see:
# https://gitlab.com/ymorin/kconfig-frontends/-/blob/master/docs/kconfig-language.txt
#

if OSYS_CPM

choice
	prompt "CP/M Version"
	---help---
		Select the CP/M version.

config CPM_22_198002
	bool
	prompt "2.2"
	---help---
		CP/M Operating System version 2.2 of February 1980

		This is the original variant and consist the parts:

		  Assembler sources:
		    - CCP:  Console Command Processor
		    - BDOS: Basic Disk Operating System

		Say yes here to generate the CP/M version 2.2 operating system
		that was written and distributed in 1979 by Digital Research
		and provided as assembler source code in state of February 1980.

endchoice

endif	# OSYS_CPM

# Local variables:
# coding: utf-8
# mode: text
# mode: kconfig
# End:
# vim: fileencoding=utf-8 filetype=kconfig :
```

## osys/cpv/Kconfig
```kconfig
#
# For a description of the syntax of this configuration file, see:
# https://gitlab.com/ymorin/kconfig-frontends/-/blob/master/docs/kconfig-language.txt
#

if OSYS_CPV

choice
	default CPV_198810_2014
	depends on OSYS_CPV
	prompt "CP/V Version"
	---help---
		Select the CP/V version.

config CPV_198810
	bool
	prompt "1988/10"
	---help---
		CP/V Operating System version of October 1988

		This is the original variant and consist the parts:

		  ROM/RAM images:
		    - CCP:  Console Command Processor
		    - BDOS: Basic Disk Operating System

		Say yes here to generate the original CP/V operating system
		that was published in the German journal "Funkamateur" in 1988.

config CPV_198810_2014
	bool
	prompt "1988/10-2014"
	---help---
		CP/V Operating System version of October 1988

		This is the disassembled variant of 1988/10 and consist the parts:

		  Assembler sources:
		    - CCP:  Console Command Processor
		    - BDOS: Basic Disk Operating System

		Say yes here to generate the disassembled CP/V operating system
		that was published in the German journal "Funkamateur" in 1988.

endchoice

endif	# OSYS_CPV

# Local variables:
# coding: utf-8
# mode: text
# mode: kconfig
# End:
# vim: fileencoding=utf-8 filetype=kconfig :
```
